## main/kconfig.projbuild
```kconfig
menu "VS1053 Setting"

    config GPIO_CS
        int "CS GPIO number"
        range 1 34
        default 5
        help
            GPIO number (IOxx) to SPI CS.
            Some GPIOs are used for other purposes (flash connections, etc.) and cannot be used to CS.
            GPIOs 35-39 are input-only so cannot be used as outputs.

    config GPIO_DCS
        int "DCS GPIO number"
        range 1 34
        default 16
        help
            GPIO number (IOxx) to SPI DCS.
            Some GPIOs are used for other purposes (flash connections, etc.) and cannot be used to DCS.
            GPIOs 35-39 are input-only so cannot be used as outputs.

    config GPIO_DREQ
        int "DREQ GPIO number"
        range 1 39
        default 4
        help
            GPIO number (IOxx) to SPI DREQ.
            Some GPIOs are used for other purposes (flash connections, etc.) and cannot be used to DREQ.
            GPIOs 35-39 are input-only so cannot be used as outputs.

    config GPIO_RESET
        int "RESET GPIO number"
        range -1 39
        default -1
        help
            GPIO number (IOxx) to RESET.
            -1 to use the hardware EN pin.
            Some GPIOs are used for other purposes (flash connections, etc.) and cannot be used to DREQ.
            GPIOs 35-39 are input-only so cannot be used as outputs.

    config VOLUME
        int "VS1053 Volume"
        range 50 100
        default 90
        help
            Volume value of VS1053.

endmenu   
menu "Example Configuration"
    
    choice EXAMPLE_IP_MODE
        prompt "IP Version"
        depends on EXAMPLE_SOCKET_IP_INPUT_STRING
        help
            Example can use either IPV4 or IPV6.

        config EXAMPLE_IPV4
            bool "IPV4"
            
        config EXAMPLE_IPV6
            bool "IPV6"

    endchoice

    config EXAMPLE_IPV4_ADDR
        string "IPV4 ADDRESS"
        default "47.96.140.186"
        depends on EXAMPLE_IPV4
        help
            the example will connect to thie IPV4 address.

    config EXAMPLE_IPV6_ADDR
        string "IPV6 ADDRESS"
        default "FE80::30AD:E57B:C212:68AD"
        depends on EXAMPLE_IPV6
        help
            the example will connect to thie IPV6 address.
    
    config EXAMPLE_PORT
        int "PORT"
        range 0 65535
        default 8080
        help
            the remote port to which the client example will connect to.

    choice EXAMPLE_SOCKET_IP_INPUT
        prompt "Socket example source"
        default EXAMPLE_SOCKET_IP_INPUT_STRING
        help
            Selects the input source of the IP used in the example.

        config EXAMPLE_SOCKET_IP_INPUT_STRING
                bool "From string"

        config EXAMPLE_SOCKET_IP_INPUT_STDIN
                bool "From stdin"        
    endchoice
    config EXAMPLE_MPUFUDU
        int "FUDU"
        range 0 180
        default 60
endmenu 
```
